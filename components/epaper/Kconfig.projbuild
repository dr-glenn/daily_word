## components/epaper/Kconfig.projbuild
```kconfig
menu "ePaper Configuration"

	choice
		prompt "Model number"
		default EPD_29
		help
			Waveshare Model
		config EPD_29
			bool "EPD_2in9"
		config EPD_27
			bool "EPD_2in7_V2"
	endchoice

	config EPD_SCK_PIN
		int "SCK"
		default 18
		help
			GPIO clock pin.

	config EPD_MOSI_PIN
		int "MOSI"
		default 23
		help
			GPIO MOSI pin.

	config EPD_CS_PIN
		int "CS"
		default 5
		help
			Chip select pin.

	config EPD_RST_PIN
		int "RST"
		default 10
		help
			Reset pin.

	config EPD_DC_PIN
		int "DC"
		default 8
		help
			Data/Command pin.

	config EPD_BUSY_PIN
		int "BUSY"
		default 11
		help
			Busy status pin.
																						
endmenu
```

## components/wifi/Kconfig.projbuild
```kconfig
menu "WiFi Configuration"

	config WIFI_SSID_PWD_FROM_STDIN
		bool "Get ssid and password from stdin"
		default n
		help
			Give the WiFi SSID and password from stdin.

	config PROVIDE_WIFI_CONSOLE_CMD
		depends on !WIFI_SSID_PWD_FROM_STDIN
		bool "Provide wifi connect commands"
		default y
		help
			Provide wifi connect commands for esp_console.
			Please use `example_register_wifi_connect_commands` to register them.

	config WIFI_SSID
		depends on !WIFI_SSID_PWD_FROM_STDIN
		string "WiFi SSID"
		default "myssid"
		help
			SSID (network name) for the example to connect to.

	config WIFI_PASSWORD
		depends on !WIFI_SSID_PWD_FROM_STDIN
		string "WiFi Password"
		default "mypassword"
		help
			WiFi password (WPA or WPA2) for the example to use.
			Can be left blank if the network has no security set.

	config WIFI_CONN_MAX_RETRY
		int "Maximum retry"
		default 6
		help
			Set the Maximum retry to avoid station reconnecting to the AP unlimited,
			in case the AP is really inexistent.

    choice ESP_WIFI_SAE_MODE
        prompt "WPA3 SAE mode selection"
        default ESP_WPA3_SAE_PWE_BOTH
        help
            Select mode for SAE as Hunt and Peck, H2E or both.
        config ESP_WPA3_SAE_PWE_HUNT_AND_PECK
            bool "HUNT AND PECK"
        config ESP_WPA3_SAE_PWE_HASH_TO_ELEMENT
            bool "H2E"
        config ESP_WPA3_SAE_PWE_BOTH
            bool "BOTH"
    endchoice

    config ESP_WIFI_PW_ID
        string "PASSWORD IDENTIFIER"
        depends on  ESP_WPA3_SAE_PWE_HASH_TO_ELEMENT|| ESP_WPA3_SAE_PWE_BOTH
        default ""
        help
            password identifier for SAE H2E

    choice ESP_WIFI_SCAN_AUTH_MODE_THRESHOLD
        prompt "WiFi Scan auth mode threshold"
        default ESP_WIFI_AUTH_WPA2_PSK
        help
            The weakest authmode to accept in the scan mode.
            This value defaults to ESP_WIFI_AUTH_WPA2_PSK incase password is present and ESP_WIFI_AUTH_OPEN is used.
            Please select ESP_WIFI_AUTH_WEP/ESP_WIFI_AUTH_WPA_PSK incase AP is operating in WEP/WPA mode.

        config ESP_WIFI_AUTH_OPEN
            bool "OPEN"
        config ESP_WIFI_AUTH_WEP
            bool "WEP"
        config ESP_WIFI_AUTH_WPA_PSK
            bool "WPA PSK"
        config ESP_WIFI_AUTH_WPA2_PSK
            bool "WPA2 PSK"
        config ESP_WIFI_AUTH_WPA_WPA2_PSK
            bool "WPA/WPA2 PSK"
        config ESP_WIFI_AUTH_WPA3_PSK
            bool "WPA3 PSK"
        config ESP_WIFI_AUTH_WPA2_WPA3_PSK
            bool "WPA2/WPA3 PSK"
        config ESP_WIFI_AUTH_WAPI_PSK
            bool "WAPI PSK"
    endchoice

endmenu
```
